#include "ota/mothership_selfupdate.h"
#include "ota/mothership_ota_release_store.h"
#include "protocol.h"           // NODE_PROTOCOL_VERSION
#include "firmware_identity.h"
#include "firmware_manifest.h"
#include "ota_installer.h"
#include "esp_ota_ops.h"        // esp_ota_get_*_partition, get_partition_description
#include "esp_partition.h"      // esp_partition_find / _next / _get
#include "esp_app_format.h"     // esp_app_desc_t

// ---------------------------------------------------------------------------
// Release verification public key (Ed25519, 32 bytes).
//
// *** PLACEHOLDER — bench/test key from scripts/release_sign.py. ***
// Before any real deployment, replace with the PRODUCTION public key whose
// private half is generated by `release_sign.py keygen` and kept offline.
// ---------------------------------------------------------------------------
static const uint8_t kReleasePubKey[32] = {
  0x29, 0x69, 0xce, 0xb7, 0x91, 0x1a, 0x2c, 0x63, 0xb6, 0x4e, 0x11, 0x52,
  0x70, 0xb9, 0xb7, 0x5c, 0xd8, 0x63, 0x32, 0x2b, 0x12, 0xf3, 0x55, 0xb5,
  0x64, 0xea, 0x47, 0x8f, 0x44, 0xe4, 0x1f, 0x3e };

// Single self-update state (one local upload at a time).
static bool                gManifestReady = false;
static bool                gInstalling    = false;
static OtaInstall          gInstall;
static uint32_t            gExpectedSize  = 0;
static char                gExpectedSha[65];
static char                gTargetVersion[16];
static char                gTargetReleaseId[40];
static uint32_t            gTargetSequence = 0;
static FwReason            gLastReason    = FW_NONE;

// Anti-downgrade source: the monotonic releaseSequence of the confirmed-running
// release, persisted in the NVS release store and promoted on a confirmed first
// boot. A never-cloud-updated device reads 0 here (store empty), which leaves
// anti-downgrade inert exactly as before — enforcement only kicks in once a
// release has actually been installed-and-confirmed through the store.
static uint32_t installedReleaseSequence() {
  return otaReleaseStoreInstalledSequence();
}

FwReason mothershipOtaVerifyManifest(const uint8_t* json, size_t len,
                                     const uint8_t sig[64],
                                     bool allowDowngrade) {
  gManifestReady = false;
  gInstalling = false;
  gExpectedSize = 0;

  if (!manifestVerifySignature(json, len, sig, kReleasePubKey)) {
    gLastReason = FW_SIGNATURE_INVALID; return gLastReason;
  }
  Manifest m;
  if (!manifestParse(json, len, m)) { gLastReason = FW_MANIFEST_INVALID; return gLastReason; }

  const ManifestArtifact* art = nullptr;
  FwReason r = manifestCheckCompatibility(m, fwIdentity(NODE_PROTOCOL_VERSION),
                                          installedReleaseSequence(), &art,
                                          allowDowngrade);
  if (r != FW_NONE || !art) { gLastReason = r; return r; }

  gExpectedSize = art->size;
  strlcpy(gExpectedSha, art->sha256, sizeof gExpectedSha);
  strlcpy(gTargetVersion, art->version, sizeof gTargetVersion);
  strlcpy(gTargetReleaseId, m.releaseId, sizeof gTargetReleaseId);
  gTargetSequence = m.releaseSequence;
  gManifestReady = true;
  gLastReason = FW_NONE;
  return FW_NONE;
}

FwReason mothershipOtaImageChunk(const uint8_t* data, size_t len) {
  if (!gManifestReady) { gLastReason = FW_MANIFEST_INVALID; return gLastReason; }
  if (!gInstalling) {
    FwReason r = otaInstallBegin(gInstall, gExpectedSize, gExpectedSha);
    if (r != FW_NONE) { gLastReason = r; return r; }
    gInstalling = true;
  }
  FwReason r = otaInstallWrite(gInstall, data, len);
  if (r != FW_NONE) { gInstalling = false; gLastReason = r; }
  return r;
}

FwReason mothershipOtaImageFinish() {
  if (!gInstalling) { gLastReason = FW_IMAGE_INVALID; return gLastReason; }
  gInstalling = false;
  gLastReason = otaInstallFinish(gInstall);
  // On a successful finish the inactive slot is flashed and set as the next
  // boot target. Record it as ARMED (awaiting first-boot confirmation) so that,
  // after the cold-boot into the new slot wipes RAM, mothershipOtaFirstBootCheck()
  // knows which release/sequence to promote to INSTALLED. Shared by both the
  // local-AP and cloud install paths — additive NVS bookkeeping only; the
  // reboot/confirm behaviour operators already rely on is unchanged.
  if (gLastReason == FW_NONE && gTargetReleaseId[0] != '\0') {
    otaReleaseStoreSetArmed(gTargetReleaseId, gTargetSequence);
  }
  return gLastReason;
}

uint32_t mothershipOtaTargetSequence() { return gTargetSequence; }

void mothershipOtaAbort() {
  if (gInstalling) { otaInstallAbort(gInstall); gInstalling = false; }
  gManifestReady = false;
}

void mothershipOtaSetLastReason(FwReason r) { gLastReason = r; }

MothershipOtaStatus mothershipOtaGetStatus() {
  MothershipOtaStatus s{};
  s.manifestReady = gManifestReady;
  s.expectedSize  = gExpectedSize;
  s.written       = gInstalling ? gInstall.written : 0;
  s.lastReason    = gLastReason;
  strlcpy(s.targetVersion,  gManifestReady ? gTargetVersion  : "", sizeof s.targetVersion);
  strlcpy(s.targetReleaseId, gManifestReady ? gTargetReleaseId : "", sizeof s.targetReleaseId);
  return s;
}

// Human-readable OTA image state (shared by the running-slot summary field and
// the per-slot table below).
const char* otaImgStateStr(esp_ota_img_states_t st) {
  return (st == ESP_OTA_IMG_PENDING_VERIFY) ? "PENDING_VERIFY" :
         (st == ESP_OTA_IMG_VALID)          ? "CONFIRMED" :
         (st == ESP_OTA_IMG_INVALID)        ? "INVALID" :
         (st == ESP_OTA_IMG_ABORTED)        ? "ABORTED" : "IDLE";
}

// (OtaSlotInfo is declared in the header so fixture tests can build slots[].)

// Enumerate the OTA app slots (app0/app1). The RUNNING slot's identity comes
// from the compiled-in firmware_identity (authoritative). The other slot's
// version is read from its on-flash app descriptor (esp_app_desc_t) — accurate
// for what physically sits there; buildId for the inactive slot is left empty
// until the NVS release store (releaseId) lands. Returns the slot count.
static int readOtaSlots(OtaSlotInfo out[], int maxSlots, const FirmwareIdentity& runId) {
  const esp_partition_t* run  = esp_ota_get_running_partition();
  const esp_partition_t* boot = esp_ota_get_boot_partition();
  int n = 0;
  esp_partition_iterator_t it =
      esp_partition_find(ESP_PARTITION_TYPE_APP, ESP_PARTITION_SUBTYPE_ANY, nullptr);
  while (it != nullptr) {
    const esp_partition_t* p = esp_partition_get(it);
    // Only the OTA app slots — skip factory/test partitions.
    if (p && n < maxSlots &&
        p->subtype >= ESP_PARTITION_SUBTYPE_APP_OTA_0 &&
        p->subtype <= ESP_PARTITION_SUBTYPE_APP_OTA_15) {
      OtaSlotInfo& s = out[n];
      memset(&s, 0, sizeof(s));
      strncpy(s.label, p->label, sizeof(s.label) - 1);
      s.active   = (run  && p->address == run->address);
      s.nextBoot = (boot && p->address == boot->address);

      esp_ota_img_states_t st = ESP_OTA_IMG_UNDEFINED;
      if (esp_ota_get_state_partition(p, &st) != ESP_OK) st = ESP_OTA_IMG_UNDEFINED;
      esp_app_desc_t desc{};
      s.present = (esp_ota_get_partition_description(p, &desc) == ESP_OK);

      if (s.active) {
        strncpy(s.version, runId.semver,  sizeof(s.version) - 1);
        strncpy(s.buildId, runId.buildId, sizeof(s.buildId) - 1);
        s.state = otaImgStateStr(st);
      } else if (s.present) {
        strncpy(s.version, desc.version, sizeof(s.version) - 1);
        s.state = otaImgStateStr(st);
      } else {
        s.state = "EMPTY";
      }
      n++;
    }
    it = esp_partition_next(it);  // releases the current handle
  }
  return n;
}

// Append the slots[] array. Split out so the JSON shape can be exercised with
// fixture data (see tests/test_firmware_slots.cpp) independent of esp_ota.
String mothershipFwSlotsJson(const OtaSlotInfo* slots, int n) {
  String j = "[";
  for (int i = 0; i < n; ++i) {
    if (i) j += ",";
    j += "{\"label\":\"";     j += slots[i].label;
    j += "\",\"version\":\""; j += slots[i].version;
    j += "\",\"buildId\":\""; j += slots[i].buildId;
    j += "\",\"state\":\"";   j += slots[i].state;
    j += "\",\"active\":";    j += slots[i].active   ? "true" : "false";
    j += ",\"nextBoot\":";    j += slots[i].nextBoot ? "true" : "false";
    j += ",\"present\":";     j += slots[i].present  ? "true" : "false";
    j += "}";
  }
  j += "]";
  return j;
}

String mothershipFirmwareStatusJson() {
  FirmwareIdentity id = fwIdentity(NODE_PROTOCOL_VERSION);
  const esp_partition_t* run  = esp_ota_get_running_partition();
  const esp_partition_t* boot = esp_ota_get_boot_partition();
  esp_ota_img_states_t st = ESP_OTA_IMG_UNDEFINED;
  if (run) esp_ota_get_state_partition(run, &st);
  const char* otaState = otaImgStateStr(st);

  OtaSlotInfo slots[4];
  const int nslots = readOtaSlots(slots, 4, id);

  String j = "{\"role\":\"";           j += id.role;
  j += "\",\"version\":\"";           j += id.semver;
  j += "\",\"buildId\":\"";            j += id.buildId;
  j += "\",\"hwTarget\":\"";           j += id.hwTarget;
  j += "\",\"protocolVersion\":";      j += String(id.protocolVersion);
  // releaseId of the confirmed-running release, from the NVS release store
  // (null until the device has installed-and-confirmed a release through OTA).
  char installedRid[40] = {0};
  const bool haveRid = otaReleaseStoreInstalledReleaseId(installedRid, sizeof(installedRid));
  if (haveRid) { j += ",\"releaseId\":\""; j += installedRid; j += "\""; }
  else         { j += ",\"releaseId\":null"; }
  // Cloud-OTA lifecycle visibility (additive). `pendingReleaseId` = a staged
  // DEPLOY_RELEASE fetch intent not yet installed; `armedReleaseId` = an image
  // flashed and boot-armed, awaiting first-boot confirmation. If armedReleaseId
  // is set but the running releaseId differs on a later check-in, the dashboard
  // can infer a rollback occurred.
  char pendingRid[40] = {0};
  const bool havePending = otaReleaseStoreGetPending(pendingRid, sizeof(pendingRid));
  if (havePending) { j += ",\"pendingReleaseId\":\""; j += pendingRid; j += "\""; }
  else             { j += ",\"pendingReleaseId\":null"; }
  char armedRid[40] = {0};
  uint32_t armedSeq = 0;
  const bool haveArmed = otaReleaseStoreGetArmed(armedRid, sizeof(armedRid), &armedSeq);
  if (haveArmed) { j += ",\"armedReleaseId\":\""; j += armedRid; j += "\""; }
  else           { j += ",\"armedReleaseId\":null"; }
  j += ",\"runningSlot\":\"";          j += (run ? run->label : "?");
  j += "\",\"otaState\":\"";           j += otaState;
  j += "\",\"otaReason\":\"";          j += fwReasonStr(gLastReason);
  j += "\",\"lastOtaReason\":\"";      j += fwReasonStr(gLastReason);
  // A/B slot visibility: which slot is active, which boots next, and what each
  // holds. Additive — pre-existing consumers ignore the new keys.
  j += "\",\"activeSlot\":\"";         j += (run  ? run->label  : "?");
  j += "\",\"nextBootSlot\":\"";       j += (boot ? boot->label : "?");
  j += "\",\"slots\":";                j += mothershipFwSlotsJson(slots, nslots);
  j += "}";
  return j;
}

bool mothershipOtaFirstBootCheck() {
  if (!otaIsPendingVerify()) return false;
  esp_err_t err = otaConfirmImage();
  Serial.printf("[OTA] first-boot self-test passed; image confirmed: %s\n",
                esp_err_to_name(err));
  if (err == ESP_OK) {
    // The image we just confirmed is the ARMED release — promote it to
    // INSTALLED so anti-downgrade (installedReleaseSequence) reflects it and
    // the status upload can report a real releaseId for the active slot.
    if (otaReleaseStorePromoteArmed()) {
      char rid[40] = {0};
      otaReleaseStoreInstalledReleaseId(rid, sizeof(rid));
      Serial.printf("[OTA] release promoted to installed: %s (seq %lu)\n",
                    rid[0] ? rid : "(none)",
                    (unsigned long)otaReleaseStoreInstalledSequence());
    }
  }
  return err == ESP_OK;
}
